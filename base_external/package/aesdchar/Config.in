## base_external/package/aesdchar/Config.in
```kconfig
config BR2_PACKAGE_AESDCHAR
    bool "aesdchar module"
    help
      Including the AESD character device to the kernel.
      
```

## base_external/package/ldd/Config.in
```kconfig
config BR2_PACKAGE_LDD
    bool "ldd (ldd3 kernel modules)"
    help
      Builds and installs the ldd3 example kernel modules:
      - misc-modules
      - scull-modules
```
